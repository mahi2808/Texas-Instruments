/**
 * @cliArgs --device "MSPM0G350X" --part "Default" --package "LQFP-64(PM)" --product "mspm0_sdk@2.08.00.02"
 * @versions {"tool":"1.25.0+4268"}
 */

/**
 * Import the modules used in this configuration.
 */
const Board         = scripting.addModule("/ti/driverlib/Board");
const COMP          = scripting.addModule("/ti/driverlib/COMP", {}, false);
const COMP1         = COMP.addInstance();
const SYSCTL        = scripting.addModule("/ti/driverlib/SYSCTL");
const ProjectConfig = scripting.addModule("/ti/project_config/ProjectConfig");

/**
 * Write custom configuration values to the imported modules.
 */

COMP1.$name                          = "COMP_0";
COMP1.outputEnable                   = true;
COMP1.posChannel                     = "DL_COMP_IPSEL_CHANNEL_1";
COMP1.negChannel                     = "DL_COMP_IMSEL_CHANNEL_1";
COMP1.channelEnable                  = ["NEG","POS"];
COMP1.compPinOutConfig.$name         = "ti_driverlib_gpio_GPIOPinGeneric2";
COMP1.peripheral.$assign             = "COMP0";
COMP1.peripheral.compPinOut.$assign  = "PB23";
COMP1.peripheral.compPinPos1.$assign = "PA18";
COMP1.peripheral.compPinNeg1.$assign = "PA17";
COMP1.compPinPos1Config.$name        = "ti_driverlib_gpio_GPIOPinGeneric0";
COMP1.compPinNeg1Config.$name        = "ti_driverlib_gpio_GPIOPinGeneric1";

SYSCTL.clockTreeEn = true;

/**
 * Pinmux solution for unlocked pins/peripherals. This ensures that minor changes to the automatic solver in a future
 * version of the tool will not impact the pinmux you originally saw.  These lines can be completely deleted in order to
 * re-solve from scratch.
 */
Board.peripheral.$suggestSolution          = "DEBUGSS";
Board.peripheral.swclkPin.$suggestSolution = "PA20";
Board.peripheral.swdioPin.$suggestSolution = "PA19";
