/**
 * @cliArgs --device "MSPM0G350X" --part "Default" --package "LQFP-64(PM)" --product "mspm0_sdk@2.07.00.06"
 * @versions {"tool":"1.25.0+4268"}
 */

/**
 * Import the modules used in this configuration.
 */
const Board         = scripting.addModule("/ti/driverlib/Board");
const GPIO          = scripting.addModule("/ti/driverlib/GPIO", {}, false);
const GPIO1         = GPIO.addInstance();
const GPIO2         = GPIO.addInstance();
const GPIO3         = GPIO.addInstance();
const GPIO4         = GPIO.addInstance();
const ProjectConfig = scripting.addModule("/ti/project_config/ProjectConfig");

/**
 * Write custom configuration values to the imported modules.
 */

GPIO1.$name                         = "GPIO_GRP_0";
GPIO1.port                          = "PORTA";
GPIO1.associatedPins[0].$name       = "PIN_0";
GPIO1.associatedPins[0].assignedPin = "0";

GPIO2.$name                         = "GPIO_GRP_1";
GPIO2.port                          = "PORTB";
GPIO2.associatedPins[0].$name       = "PIN_1";
GPIO2.associatedPins[0].assignedPin = "22";

GPIO3.$name                         = "GPIO_GRP_2";
GPIO3.port                          = "PORTB";
GPIO3.associatedPins[0].$name       = "PIN_2";
GPIO3.associatedPins[0].assignedPin = "26";

GPIO4.$name                         = "GPIO_GRP_3";
GPIO4.port                          = "PORTB";
GPIO4.associatedPins[0].$name       = "PIN_3";
GPIO4.associatedPins[0].assignedPin = "27";

const SYSCTL = scripting.addModule("/ti/driverlib/SYSCTL", {}, false);

ProjectConfig.genLibDL = false;

/**
 * Pinmux solution for unlocked pins/peripherals. This ensures that minor changes to the automatic solver in a future
 * version of the tool will not impact the pinmux you originally saw.  These lines can be completely deleted in order to
 * re-solve from scratch.
 */
Board.peripheral.$suggestSolution            = "DEBUGSS";
Board.peripheral.swclkPin.$suggestSolution   = "PA20";
Board.peripheral.swdioPin.$suggestSolution   = "PA19";
GPIO1.associatedPins[0].pin.$suggestSolution = "PA0";
GPIO2.associatedPins[0].pin.$suggestSolution = "PB22";
GPIO3.associatedPins[0].pin.$suggestSolution = "PB26";
GPIO4.associatedPins[0].pin.$suggestSolution = "PB27";
SYSCTL.peripheral.$suggestSolution           = "SYSCTL";
