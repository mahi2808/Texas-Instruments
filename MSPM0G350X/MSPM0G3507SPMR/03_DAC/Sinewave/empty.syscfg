/**
 * @cliArgs --device "MSPM0G350X" --part "Default" --package "LQFP-64(PM)" --product "mspm0_sdk@2.08.00.03"
 * @versions {"tool":"1.25.0+4268"}
 */

/**
 * Import the modules used in this configuration.
 */
const Board         = scripting.addModule("/ti/driverlib/Board");
const DAC12         = scripting.addModule("/ti/driverlib/DAC12");
const SYSCTL        = scripting.addModule("/ti/driverlib/SYSCTL");
const TIMER         = scripting.addModule("/ti/driverlib/TIMER", {}, false);
const TIMER1        = TIMER.addInstance();
const ProjectConfig = scripting.addModule("/ti/project_config/ProjectConfig");

/**
 * Write custom configuration values to the imported modules.
 */
const gate8  = system.clockTree["MFPCLKGATE"];
gate8.enable = true;


DAC12.dacOutputPinEn     = true;
DAC12.dacAmplifier       = "ON";
DAC12.OutPinConfig.$name = "ti_driverlib_gpio_GPIOPinGeneric0";

SYSCTL.clockTreeEn = true;

TIMER1.$name               = "TIMER_0";
TIMER1.timerClkPrescale    = 32;
TIMER1.timerMode           = "PERIODIC";
TIMER1.enableRepeatCounter = true;
TIMER1.interrupts          = ["REPC"];
TIMER1.repeatCounter       = 2;
TIMER1.timerPeriod         = "1us";

/**
 * Pinmux solution for unlocked pins/peripherals. This ensures that minor changes to the automatic solver in a future
 * version of the tool will not impact the pinmux you originally saw.  These lines can be completely deleted in order to
 * re-solve from scratch.
 */
Board.peripheral.$suggestSolution          = "DEBUGSS";
Board.peripheral.swclkPin.$suggestSolution = "PA20";
Board.peripheral.swdioPin.$suggestSolution = "PA19";
DAC12.peripheral.$suggestSolution          = "DAC0";
DAC12.peripheral.OutPin.$suggestSolution   = "PA15";
TIMER1.peripheral.$suggestSolution         = "TIMA0";
